## main/Kconfig.projbuild
```kconfig
menu "esp32-avr-i2c Configuration"

config ONBOARD_LED_GPIO
    int "Onboard LED GPIO number"
    range 0 34
    default 2
    help
        GPIO number (IOxx) connected to onboard LED.

config I2C_MASTER_SCL_GPIO
    int "I2C Master SCL GPIO number"
    range 0 34
    default 19
    help
        GPIO number (IOxx) for I2C SCL.

        Some GPIOs are used for other purposes (flash connections, etc.) and cannot be used.

        GPIOs 35-39 are input-only so cannot be used to drive the I2C bus.

config I2C_MASTER_SDA_GPIO
    int "I2C Master SDA GPIO number"
    range 0 34
    default 18
    help
        GPIO number (IOxx) for I2C SDA.

        Some GPIOs are used for other purposes (flash connections, etc.) and cannot be used.

        GPIOs 35-39 are input-only so cannot be used to drive the I2C bus.

config AVR_I2C_ADDRESS
    hex "I2C Address for AVR device"
    default 0x44
    help
        I2C address for AVR ATtiny84A device.

config AVR_RESET_GPIO
    int "AVR Reset GPIO number"
    range 0 34
    default 21
    help
        GPIO number (IOxx) for resetting the AVR by pulling low for a period of time.

        Some GPIOs are used for other purposes (flash connections, etc.) and cannot be used.

        GPIOs 35-39 are input-only so cannot be used to reset the AVR.
        
endmenu
```
